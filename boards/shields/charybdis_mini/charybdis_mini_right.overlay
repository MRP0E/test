#include "charybdis_mini.dtsi"

/ {
    kscan0: kscan0 {
        compatible = "zmk,kscan-gpio-matrix";
                diode-direction = "col2row";
        wakeup-source;

        col-gpios
            = <&pro_micro 8 GPIO_ACTIVE_HIGH>
            ;

        row-gpios
            = <&pro_micro 7 (GPIO_ACTIVE_HIGH | GPIO_PULL_DOWN)>
            ;
    };
};

&physical_layout_charybdis_mini {
    kscan = <&kscan0>;
};
// == Input devices ==
// Enabling input-split for its own input devices
// Adding input devices and assigning them to input-split
&input_split_right0 {
    status = "okay";
    device = <&input_device_right0>;
};

