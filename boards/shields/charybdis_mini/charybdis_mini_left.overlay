#include "charybdis_mini.dtsi"

&physical_layout_charybdis_mini {
    kscan = <&kscan0>;
};
// == Input devices ==
// Input devices on peripheral parts
// Enabling input listeners and input-split to receive input events from peripherals
&input_split_right0 { status = "okay"; };
&input_listener_right0 { status = "okay"; };

